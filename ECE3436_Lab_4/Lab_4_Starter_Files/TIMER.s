;TIMER INIT
;VARIABLES
; NVIC REGISTERS
NVIC_ST_CTRL_R	   EQU 0xE000E010
NVIC_ST_RELOAD_R   EQU 0xE000E014
NVIC_ST_CURRENT_R  EQU 0xE000E018
TIME_12MS 		   EQU 1000000
TIME_1MS		   EQU 80000
	
		AREA	|.text|, CODE, READONLY, ALIGN = 2
		THUMB
		EXPORT TIMER_INIT
		EXPORT TIMER_12MS
		EXPORT TIMER_1MS

TIMER_INIT
	LDR R1, =NVIC_ST_CTRL_R
	MOV R0, #0
	STR R0, [R1]
	LDR R1, =NVIC_ST_RELOAD_R
	LDR R0, =0x00FFFFFF
	STR R0, [R1]
	LDR R1, =NVIC_ST_CURRENT_R
	MOV R0, #0
	STR R0, [R1]
	LDR R1, =NVIC_ST_CTRL_R
	MOV R0, #0x05
	STR R0, [R1]
	BX LR
	
TIMER_WAIT	
	LDR R1, =NVIC_ST_RELOAD_R
	SUB R0, #1
	STR R0, [R1]
	LDR R1, =NVIC_ST_CTRL_R	
TIMER_WAIT_LOOP
	LDR R3, [R1]
	ANDS R3, R3, #0x00010000
	BEQ TIMER_WAIT_LOOP
	BX LR
	
TIMER_12MS
	PUSH {R4, LR}
	MOVS R4, R0
	BEQ TIMER_12MS_DONE	
TIMER_12MS_LOOP
	LDR R0, =TIME_12MS
	BL TIMER_WAIT
	SUBS R4, R4, #1
	BHI TIMER_12MS_LOOP
TIMER_12MS_DONE
	POP {R4, PC}
	BX LR
	
TIMER_1MS
	PUSH {R4, LR}
	MOVS R4, R0
	BEQ TIMER_1MS_DONE
TIMER_1MS_LOOP
	LDR R0, =TIME_1MS
	BL TIMER_WAIT
	SUBS R4, R4, #1
	BHI TIMER_1MS_LOOP
TIMER_1MS_DONE
	POP {R4, PC}
	BX LR

	ALIGN
	END